## firmware/artemis/Kconfig.defconfig
```kconfig
# Copyright (c) 2020 The ZMK Contributors
# SPDX-License-Identifier: MIT

if SHIELD_ARTEMIS_LEFT

config ZMK_KEYBOARD_NAME
	default "ARTEMIS_L"

config ZMK_SPLIT_BLE_ROLE_CENTRAL
	default y

endif

if SHIELD_ARTEMIS_RIGHT

config ZMK_KEYBOARD_NAME
	default "ARTEMIS_R"

endif

if SHIELD_ARTEMIS_RIGHT || SHIELD_ARTEMIS_LEFT

config ZMK_SPLIT
	default y

endif
```

## firmware/artemis/Kconfig.shield
```kconfig
# Copyright (c) 2020 The ZMK Contributors
# SPDX-License-Identifier: MIT

config SHIELD_ARTEMIS_LEFT
	def_bool $(shields_list_contains,artemis_left)

config SHIELD_ARTEMIS_RIGHT
	def_bool $(shields_list_contains,artemis_right)
```
